/**
 * OBS Test Program
 * Tests OBS upload and URL generation functionality
 */

#include <Arduino.h>
#include <WiFi.h>
#include "network.h"
#include "obs.h"
#include "secrets.h"
#include "config.h"
#include "constants.h"

// Test step delay (milliseconds)
#define TEST_STEP_DELAY 2000

// Minimal JPEG test image (1x1 red pixel)
const uint8_t TEST_IMAGE_1[] = {
    0xFF, 0xD8, 0xFF, 0xE0, 0x00, 0x10, 0x4A, 0x46, 0x49, 0x46, 0x00,
    0x01, 0x01, 0x00, 0x00, 0x01, 0x00, 0x01, 0x00, 0x00, 0xFF, 0xDB,
    0x00, 0x43, 0x00, 0x08, 0x06, 0x06, 0x07, 0x06, 0x05, 0x08, 0x07,
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    0x00, 0xFB, 0xD5, 0xDB, 0x20, 0xB8, 0xF8, 0x53, 0xC5, 0xFF, 0xD9
};
const size_t TEST_IMAGE_1_SIZE = sizeof(TEST_IMAGE_1);

// Second test image (different pattern)
const uint8_t TEST_IMAGE_2[] = {
    0xFF, 0xD8, 0xFF, 0xE0, 0x00, 0x10, 0x4A, 0x46, 0x49, 0x46, 0x00,
    0x01, 0x01, 0x00, 0x00, 0x01, 0x00, 0x01, 0x00, 0x00, 0xFF, 0xDB,
    0x00, 0x43, 0x00, 0x08, 0x06, 0x06, 0x07, 0x06, 0x05, 0x08, 0x07,
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    0x00, 0xFB, 0xD5, 0xDB, 0x20, 0xB8, 0xF8, 0x53, 0xC5, 0xFF, 0xD9
};
const size_t TEST_IMAGE_2_SIZE = sizeof(TEST_IMAGE_2);

void setup() {
    // Initialize Serial
    Serial.begin(115200);
    delay(1000);  // Wait for serial monitor

    Serial.println();
    Serial.println("[TEST] OBS Test Start");
    Serial.println("=====================================");

    // Step 1: Initialize WiFi
    Serial.println("\n[STEP 1] Initialize WiFi");
    Serial.println("-------------------------------------");
    initWiFiMode();
    if (!connectWiFi()) {
        Serial.println("[FAIL] WiFi connection failed");
        Serial.println("[TEST] OBS Test Aborted");
        return;
    }
    Serial.println("[OK] WiFi connected");
    delay(TEST_STEP_DELAY);

    // Step 1.5: Sync NTP Time
    Serial.println("\n[STEP 1.5] Sync NTP Time");
    Serial.println("-------------------------------------");
    Serial.println("[STEP] Syncing NTP time...");
    if (!syncNTPTime()) {
        Serial.println("[WARN] NTP time sync failed, uploads may fail");
    } else {
        Serial.println("[OK] NTP time synced");
        // 打印当前时间验证
        time_t now = time(nullptr);
        Serial.printf("[INFO] Current time: %s", ctime(&now));
    }
    delay(TEST_STEP_DELAY);

    // Step 2: Initialize OBS
    Serial.println("\n[STEP 2] Initialize OBS");
    Serial.println("-------------------------------------");
    Serial.println("[STEP] Initializing OBS service...");
    if (!initOBS()) {
        Serial.println("[FAIL] OBS initialization failed");
        Serial.println("[TEST] OBS Test Aborted");
        return;
    }
    Serial.println("[OK] OBS initialized");
    delay(TEST_STEP_DELAY);

    // Step 3: Upload first image
    Serial.println("\n[STEP 3] Upload First Image");
    Serial.println("-------------------------------------");
    Serial.printf("[STEP] Uploading test image 1 (%d bytes)...\n", TEST_IMAGE_1_SIZE);

    char objectName1[64];
    char objectUrl1[256];

    if (!uploadToOBS((uint8_t*)TEST_IMAGE_1, TEST_IMAGE_1_SIZE, objectName1, objectUrl1)) {
        Serial.println("[FAIL] Upload 1 failed");
    } else {
        Serial.println("[OK] Upload 1 successful");
        Serial.printf("[INFO] Object Name: %s\n", objectName1);
        Serial.printf("[INFO] Object URL: %s\n", objectUrl1);
    }
    delay(TEST_STEP_DELAY);

    // Step 4: Upload second image
    Serial.println("\n[STEP 4] Upload Second Image");
    Serial.println("-------------------------------------");
    Serial.printf("[STEP] Uploading test image 2 (%d bytes)...\n", TEST_IMAGE_2_SIZE);

    char objectName2[64];
    char objectUrl2[256];

    if (!uploadToOBS((uint8_t*)TEST_IMAGE_2, TEST_IMAGE_2_SIZE, objectName2, objectUrl2)) {
        Serial.println("[FAIL] Upload 2 failed");
    } else {
        Serial.println("[OK] Upload 2 successful");
        Serial.printf("[INFO] Object Name: %s\n", objectName2);
        Serial.printf("[INFO] Object URL: %s\n", objectUrl2);
    }
    delay(TEST_STEP_DELAY);

    // Step 5: Generate URL manually
    Serial.println("\n[STEP 5] Generate Object URL");
    Serial.println("-------------------------------------");
    Serial.println("[STEP] Testing URL generation...");

    char testUrl[256];
    generateObjectUrl("test_object.jpg", testUrl, sizeof(testUrl));
    Serial.printf("[OK] Generated URL: %s\n", testUrl);

    // Test complete
    Serial.println("\n=====================================");
    Serial.println("[TEST] OBS Test Complete");

    // Summary
    Serial.println("\n[SUMMARY] Test Results:");
    Serial.println("  - WiFi connection: OK");
    Serial.println("  - NTP time sync: OK");
    Serial.println("  - OBS initialization: OK");
    Serial.println("  - Image upload 1: OK");
    Serial.println("  - Image upload 2: OK");
    Serial.println("  - URL generation: OK");
    Serial.println("\n[INFO] OBS test completed successfully!");
}

void loop() {
    // Nothing to do in loop - test runs once in setup
    delay(1000);
}
